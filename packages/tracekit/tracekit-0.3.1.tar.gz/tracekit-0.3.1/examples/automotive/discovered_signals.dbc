VERSION ""

NS_ :

BS_:

BU_:

BO_ 640 Engine_Status: 8 Vector__XXX
 SG_ engine_rpm : 16|16@0+ (0.25,0.0) [0|0] "rpm" Vector__XXX

CM_ SG_ 640 engine_rpm "Statistical analysis; Value range matches expectations";
